/ {
    behaviors {

        /* レイヤー1をMomentaryで開き、TapではSpaceを出す例 */
        my_lt_hp: my_layer_tap_holdpref {
            compatible = "zmk,behavior-hold-tap";
            #binding-cells = <2>;           /* <hold-action> <tap-action> */
            flavor = "hold-preferred";      /* ←インタラプトですぐ Hold */
            tapping-term-ms = <200>;        /* 好みで調整 */
            bindings = <&mo>, <&kp>;        /* hold=Momentary layer, tap=Key press */
        };

    };
};
