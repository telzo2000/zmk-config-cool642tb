## config/west.yml
```yaml
manifest:
  remotes:
    - name: zmkfirmware
      url-base: https://github.com/zmkfirmware
    - name: telzo2000
      url-base: https://github.com/telzo2000
  projects:
    - name: zmk
      remote: zmkfirmware
      revision: v0.3
      import: app/west.yml
    - name: zmk-pmw3610-driver
      remote: telzo2000
      revision: main
    - name: zmk-dynamic-keymapper
      url: https://github.com/alektor-diy/zmk-dynamic-keymapper
      revision: main
  self:
    path: config
    
```
